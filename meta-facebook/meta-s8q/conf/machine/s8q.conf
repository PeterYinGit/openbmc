## meta-facebook/meta-s8q/conf/machine/s8q.conf
```bitbake
# S8Q config file.

KMACHINE = "aspeed"
KERNEL_DEVICETREE = "aspeed/${KMACHINE}-bmc-facebook-${MACHINE}.dtb"

UBOOT_MACHINE = "ast2600_openbmc_spl_defconfig"
UBOOT_DEVICETREE = "ast2600-facebook"

SPL_BINARY = "spl/u-boot-spl.bin"
SOCSEC_SIGN_ENABLE = "0"

OBMC_COMPATIBLE_NAMES = "com.meta.Hardware.BMC.Model.S8Q"

require conf/distro/include/phosphor-static-norootfs.inc
require conf/distro/include/pldm.inc
require conf/machine/include/ast2600.inc
require conf/machine/include/facebook-compute-amd.inc
require conf/machine/include/facebook-compute-singlehost.inc
require conf/machine/include/facebook-liquid-cooled.inc
require conf/machine/include/facebook-ncsi-nic.inc
require conf/machine/include/obmc-bsp-common.inc
require conf/machine/include/tpm2.inc

FLASH_SIZE = "98304"

# 96MB flash@0 分區設定 (單位: KB)
FLASH_UBOOT_OFFSET = "0"
FLASH_MANIFEST_OFFSET = "888"
FLASH_UBOOT_ENV_OFFSET = "896"
FLASH_KERNEL_OFFSET = "1024"
FLASH_ROFS_OFFSET = "10240"
FLASH_RWFS_OFFSET = "98304" 

VIRTUAL-RUNTIME_obmc-host-state-manager = "phosphor-state-manager-host"
VIRTUAL-RUNTIME_obmc-chassis-state-manager = "phosphor-state-manager-chassis"

# Note: S8Q chassis instance configuration
OBMC_CHASSIS_INSTANCES = "0 1"
```
