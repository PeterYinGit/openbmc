## meta-facebook/meta-optic/conf/layer.conf
```bitbake
# We have a conf and classes directory, add to BBPATH
BBPATH .= ":${LAYERDIR}"

# We have recipes-* directories, add to BBFILES
BBFILES += "${LAYERDIR}/recipes-*/*/*.bb \
            ${LAYERDIR}/recipes-*/*/*.bbappend"

BBFILE_COLLECTIONS += "optic-layer"
BBFILE_PATTERN_optic-layer := "^${LAYERDIR}/"

LAYERSERIES_COMPAT_optic-layer := "wrynose whinlatter"
```
